## sdkconfig.defaults
```kconfig
# 工程默认配置（首次构建时会据此生成 sdkconfig）
# 默认目标芯片为 esp32，可用 `idf.py set-target esp32s3` 等命令切换

# 串口日志波特率
CONFIG_ESP_CONSOLE_UART_BAUDRATE=115200

# ============= LVGL 9.x =============
# 使用 Kconfig 而非 lv_conf.h
CONFIG_LV_CONF_SKIP=y
CONFIG_LV_CONF_MINIMAL=n

# 颜色深度 RGB565, 与 ST7789 一致
CONFIG_LV_COLOR_DEPTH_16=y

# 内存: 使用标准 C 库 malloc/free (IDF 提供)
CONFIG_LV_USE_CLIB_MALLOC=y
CONFIG_LV_USE_CLIB_STRING=y
CONFIG_LV_USE_CLIB_SPRINTF=y

# 操作系统: FreeRTOS
CONFIG_LV_OS_FREERTOS=y
CONFIG_LV_USE_FREERTOS_TASK_NOTIFY=y

# 显示刷新周期 30ms (~33fps)
CONFIG_LV_DISP_DEF_REFR_PERIOD=30

# 关闭 examples/demos, 节省 flash
CONFIG_LV_BUILD_EXAMPLES=n
CONFIG_LV_BUILD_DEMOS=n

# 默认字体 Montserrat 14
CONFIG_LV_FONT_MONTSERRAT_14=y
# 大号字体, 用于秒数等大字显示
CONFIG_LV_FONT_MONTSERRAT_40=y
CONFIG_LV_FONT_MONTSERRAT_20=y
CONFIG_LV_FONT_MONTSERRAT_28=y

# 日志 (调试期开启)
CONFIG_LV_USE_LOG=y
CONFIG_LV_LOG_PRINTF=y
CONFIG_LV_LOG_LEVEL_WARN=y
```
